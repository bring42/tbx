/*
 * WiFi Scanner Tool
 * Scans for nearby WiFi networks and displays them in a web UI
 */

#include <Arduino.h>
#include <ArduinoJson.h>
#include "toolbox_common.h"
#include "toolbox_wifi.h"
#include "toolbox_web.h"
#include "toolbox_ota.h"
#include "web_ui_gz.h"  // Generated by build_web.py

// ============ CONFIGURATION ============
#define PREFS_NS        "wifiscan"
#define DEFAULT_SCAN_INTERVAL 10  // seconds

// ============ STATE ============
uint32_t scanInterval = DEFAULT_SCAN_INTERVAL;
unsigned long lastScanTime = 0;
bool scanning = false;

// ============ HELPERS ============

const char* authModeToString(wifi_auth_mode_t mode) {
    switch (mode) {
        case WIFI_AUTH_OPEN:            return "Open";
        case WIFI_AUTH_WEP:             return "WEP";
        case WIFI_AUTH_WPA_PSK:         return "WPA";
        case WIFI_AUTH_WPA2_PSK:        return "WPA2";
        case WIFI_AUTH_WPA_WPA2_PSK:    return "WPA/WPA2";
        case WIFI_AUTH_WPA2_ENTERPRISE: return "WPA2-Enterprise";
        case WIFI_AUTH_WPA3_PSK:        return "WPA3";
        default:                        return "Unknown";
    }
}

void performScan() {
    scanning = true;

    // Broadcast scanning status
    JsonDocument statusDoc;
    statusDoc["type"]     = "status";
    statusDoc["uptime"]   = millis() / 1000;
    statusDoc["heap"]     = ESP.getFreeHeap();
    statusDoc["scanning"] = true;
    tbWifiStatusJson(statusDoc);
    tbWsBroadcast(statusDoc);

    int n = WiFi.scanNetworks(false, true);  // sync, show hidden
    scanning = false;
    lastScanTime = millis();
    tbLedFlash();

    // Sort by RSSI (strongest first) using simple bubble sort
    if (n > 1) {
        // Build index array for sorting
        int indices[n];
        for (int i = 0; i < n; i++) indices[i] = i;
        for (int i = 0; i < n - 1; i++) {
            for (int j = 0; j < n - i - 1; j++) {
                if (WiFi.RSSI(indices[j]) < WiFi.RSSI(indices[j + 1])) {
                    int tmp = indices[j];
                    indices[j] = indices[j + 1];
                    indices[j + 1] = tmp;
                }
            }
        }

        // Build response
        JsonDocument resp;
        resp["type"]  = "scan";
        resp["count"] = n;
        JsonArray nets = resp["networks"].to<JsonArray>();
        for (int i = 0; i < n && i < 30; i++) {
            int idx = indices[i];
            JsonObject net = nets.add<JsonObject>();
            net["ssid"]       = WiFi.SSID(idx);
            net["rssi"]       = WiFi.RSSI(idx);
            net["channel"]    = WiFi.channel(idx);
            net["encryption"] = authModeToString(WiFi.encryptionType(idx));
            net["bssid"]      = WiFi.BSSIDstr(idx);
        }
        tbWsBroadcast(resp);
    } else {
        JsonDocument resp;
        resp["type"]  = "scan";
        resp["count"] = (n > 0) ? n : 0;
        resp["networks"].to<JsonArray>();
        tbWsBroadcast(resp);
    }

    WiFi.scanDelete();
}

// ============ WEBSOCKET HANDLER ============
void handleToolWS(AsyncWebSocketClient* client, JsonDocument& doc) {
    const char* cmd = doc["cmd"];

    if (strcmp(cmd, "status") == 0) {
        JsonDocument resp;
        resp["type"]     = "status";
        resp["uptime"]   = millis() / 1000;
        resp["heap"]     = ESP.getFreeHeap();
        resp["scanning"] = scanning;
        tbWifiStatusJson(resp);
        tbWsReply(client, resp);
    }
    else if (strcmp(cmd, "settings") == 0) {
        JsonDocument resp;
        resp["type"]     = "settings";
        resp["interval"] = scanInterval;
        tbWifiSettingsJson(resp);
        tbWsReply(client, resp);
    }
    else if (strcmp(cmd, "scan") == 0) {
        performScan();
    }
    else if (strcmp(cmd, "savesettings") == 0) {
        uint32_t interval = doc["interval"] | DEFAULT_SCAN_INTERVAL;
        if (interval < 5) interval = 5;
        if (interval > 300) interval = 300;
        scanInterval = interval;

        Preferences prefs;
        prefs.begin(PREFS_NS, false);
        prefs.putUInt("interval", scanInterval);
        prefs.end();

        JsonDocument resp;
        resp["type"]     = "settings";
        resp["interval"] = scanInterval;
        tbWifiSettingsJson(resp);
        tbWsBroadcast(resp);
    }
    else if (strcmp(cmd, "savewifi") == 0) {
        const char* ssid = doc["ssid"];
        const char* pass = doc["pass"];
        if (ssid && strlen(ssid) > 0 && strlen(ssid) <= 32) {
            tbWifiSave(PREFS_NS, ssid, pass ? pass : "");
        }
    }
    else if (strcmp(cmd, "clearHistory") == 0) {
        JsonDocument resp;
        resp["type"] = "cleared";
        tbWsBroadcast(resp);
    }
}

// ============ SETUP ============
void setup() {
    Serial.begin(115200);
    delay(1000);

    tbLedBegin();
    tbWifiBegin("WiFiScanner", "scanner1234", PREFS_NS, "wifiscan");
    tbWebBegin(INDEX_HTML_GZ, INDEX_HTML_GZ_LEN, handleToolWS);
    tbOtaBegin();

    // Load saved scan interval
    Preferences prefs;
    prefs.begin(PREFS_NS, true);
    scanInterval = prefs.getUInt("interval", DEFAULT_SCAN_INTERVAL);
    prefs.end();

    Serial.println("\n  WiFi Scanner Tool ready.");
    Serial.printf("  Auto-scan interval: %d seconds\n\n", scanInterval);
}

// ============ LOOP ============
void loop() {
    // Auto-scan on interval
    unsigned long now = millis();
    if (!scanning && (now - lastScanTime >= scanInterval * 1000)) {
        performScan();
    }

    tbWifiLoop();
    tbWebLoop();
    tbOtaLoop();
    tbLedBlink();
    yield();
}
