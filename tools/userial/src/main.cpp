/*
 * RS-232 Serial Tool
 * Dual-channel serial monitor, injector, and passthrough bridge.
 */

#include <Arduino.h>
#include <ArduinoJson.h>
#include <Preferences.h>
#include <ctype.h>
#include <string.h>
#include "toolbox_common.h"
#include "toolbox_wifi.h"
#include "toolbox_web.h"
#include "toolbox_ota.h"
#include "web_ui_gz.h"  // Generated by build_web.py

// ============ CONFIGURATION ============
#ifndef SERIAL_A_TX_PIN
#define SERIAL_A_TX_PIN   5
#endif
#ifndef SERIAL_A_RX_PIN
#define SERIAL_A_RX_PIN   4
#endif
#ifndef SERIAL_B_TX_PIN
#define SERIAL_B_TX_PIN   7
#endif
#ifndef SERIAL_B_RX_PIN
#define SERIAL_B_RX_PIN   6
#endif
#define DEFAULT_BAUD      9600
#define DEFAULT_DATABITS  8
#define DEFAULT_PARITY    'N'
#define DEFAULT_STOPBITS  1
#define PREFS_NS          "serial"
#define PREVIEW_BYTES     32
#define HISTORY_SIZE      80

enum PassthroughMode : uint8_t {
    PASSTHROUGH_OFF = 0,
    PASSTHROUGH_A_TO_B = 1,
    PASSTHROUGH_B_TO_A = 2,
    PASSTHROUGH_BIDIR = 3,
};

struct ChannelState {
    const char* id;
    const char* label;
    uint8_t rxPin;
    uint8_t txPin;
    HardwareSerial* uart;
    uint32_t rxBytes;
    uint32_t txBytes;
};

struct HistoryEntry {
    uint32_t ts;
    uint16_t len;
    char port;
    char dir;
    char forwardedTo;
    char hex[(PREVIEW_BYTES * 3) + 1];
    char ascii[(PREVIEW_BYTES * 4) + 1];
};

// ============ STATE ============
HardwareSerial SerialChannelA(1);
HardwareSerial SerialChannelB(0);
ChannelState channels[] = {
    {"A", "Channel A", SERIAL_A_RX_PIN, SERIAL_A_TX_PIN, &SerialChannelA, 0, 0},
    {"B", "Channel B", SERIAL_B_RX_PIN, SERIAL_B_TX_PIN, &SerialChannelB, 0, 0},
};
HistoryEntry history[HISTORY_SIZE];
size_t historyHead = 0;
size_t historyCount = 0;
uint32_t currentBaud = DEFAULT_BAUD;
uint8_t currentDataBits = DEFAULT_DATABITS;
char currentParity = DEFAULT_PARITY;
uint8_t currentStopBits = DEFAULT_STOPBITS;
uint32_t currentSerialConfig = SERIAL_8N1;
PassthroughMode currentPassthroughMode = PASSTHROUGH_BIDIR;

// ============ HELPERS ============
size_t totalRxBytes() {
    return channels[0].rxBytes + channels[1].rxBytes;
}

size_t totalTxBytes() {
    return channels[0].txBytes + channels[1].txBytes;
}

const char* configToString() {
    static char config[5];
    snprintf(config, sizeof(config), "%u%c%u", currentDataBits, currentParity, currentStopBits);
    return config;
}

const char* passthroughModeToString(PassthroughMode mode) {
    switch (mode) {
        case PASSTHROUGH_A_TO_B: return "a_to_b";
        case PASSTHROUGH_B_TO_A: return "b_to_a";
        case PASSTHROUGH_BIDIR:  return "both";
        case PASSTHROUGH_OFF:
        default:                 return "off";
    }
}

bool resolveSerialConfig(uint8_t dataBits, char parity, uint8_t stopBits, uint32_t& config) {
    parity = toupper((unsigned char)parity);
    if (dataBits == 7 && parity == 'N' && stopBits == 1) config = SERIAL_7N1;
    else if (dataBits == 7 && parity == 'N' && stopBits == 2) config = SERIAL_7N2;
    else if (dataBits == 7 && parity == 'E' && stopBits == 1) config = SERIAL_7E1;
    else if (dataBits == 7 && parity == 'E' && stopBits == 2) config = SERIAL_7E2;
    else if (dataBits == 7 && parity == 'O' && stopBits == 1) config = SERIAL_7O1;
    else if (dataBits == 7 && parity == 'O' && stopBits == 2) config = SERIAL_7O2;
    else if (dataBits == 8 && parity == 'N' && stopBits == 1) config = SERIAL_8N1;
    else if (dataBits == 8 && parity == 'N' && stopBits == 2) config = SERIAL_8N2;
    else if (dataBits == 8 && parity == 'E' && stopBits == 1) config = SERIAL_8E1;
    else if (dataBits == 8 && parity == 'E' && stopBits == 2) config = SERIAL_8E2;
    else if (dataBits == 8 && parity == 'O' && stopBits == 1) config = SERIAL_8O1;
    else if (dataBits == 8 && parity == 'O' && stopBits == 2) config = SERIAL_8O2;
    else return false;
    return true;
}

PassthroughMode parsePassthroughMode(const char* raw) {
    if (!raw || !raw[0]) return PASSTHROUGH_BIDIR;
    if (strcmp(raw, "off") == 0) return PASSTHROUGH_OFF;
    if (strcmp(raw, "a_to_b") == 0) return PASSTHROUGH_A_TO_B;
    if (strcmp(raw, "b_to_a") == 0) return PASSTHROUGH_B_TO_A;
    if (strcmp(raw, "both") == 0 || strcmp(raw, "bidirectional") == 0) return PASSTHROUGH_BIDIR;
    return PASSTHROUGH_BIDIR;
}

int channelIndexFromId(const char* raw) {
    if (!raw || !raw[0]) return 0;
    char id = toupper((unsigned char)raw[0]);
    if (id == 'B' || id == '1') return 1;
    return 0;
}

bool passthroughEnabledFor(int sourceIndex) {
    if (sourceIndex == 0) {
        return currentPassthroughMode == PASSTHROUGH_A_TO_B || currentPassthroughMode == PASSTHROUGH_BIDIR;
    }
    return currentPassthroughMode == PASSTHROUGH_B_TO_A || currentPassthroughMode == PASSTHROUGH_BIDIR;
}

void appendAsciiPreview(char* out, size_t outSize, size_t& pos, const char* text) {
    while (*text && pos + 1 < outSize) {
        out[pos++] = *text++;
    }
}

void makeHexPreview(const uint8_t* data, size_t len, char* out, size_t outSize) {
    size_t pos = 0;
    size_t limit = len < PREVIEW_BYTES ? len : PREVIEW_BYTES;
    for (size_t i = 0; i < limit && pos + 3 < outSize; i++) {
        if (i > 0) out[pos++] = ' ';
        snprintf(out + pos, outSize - pos, "%02X", data[i]);
        pos += 2;
    }
    out[pos] = '\0';
}

void makeAsciiPreview(const uint8_t* data, size_t len, char* out, size_t outSize) {
    size_t pos = 0;
    size_t limit = len < PREVIEW_BYTES ? len : PREVIEW_BYTES;
    for (size_t i = 0; i < limit && pos + 1 < outSize; i++) {
        uint8_t value = data[i];
        if (value >= 32 && value < 127) {
            out[pos++] = (char)value;
        } else if (value == '\r') {
            appendAsciiPreview(out, outSize, pos, "\\r");
        } else if (value == '\n') {
            appendAsciiPreview(out, outSize, pos, "\\n");
        } else if (value == '\t') {
            appendAsciiPreview(out, outSize, pos, "\\t");
        } else {
            out[pos++] = '.';
        }
    }
    out[pos] = '\0';
}

void storeHistory(char port, char dir, char forwardedTo, const uint8_t* data, size_t len, uint32_t ts) {
    HistoryEntry& entry = history[historyHead];
    entry.ts = ts;
    entry.len = len > 0xFFFF ? 0xFFFF : (uint16_t)len;
    entry.port = port;
    entry.dir = dir;
    entry.forwardedTo = forwardedTo;
    makeHexPreview(data, len, entry.hex, sizeof(entry.hex));
    makeAsciiPreview(data, len, entry.ascii, sizeof(entry.ascii));

    historyHead = (historyHead + 1) % HISTORY_SIZE;
    if (historyCount < HISTORY_SIZE) historyCount++;
}

void addPayloadPreview(JsonDocument& doc, const uint8_t* data, size_t len) {
    char hex[(PREVIEW_BYTES * 3) + 1];
    char ascii[(PREVIEW_BYTES * 4) + 1];
    makeHexPreview(data, len, hex, sizeof(hex));
    makeAsciiPreview(data, len, ascii, sizeof(ascii));
    doc["hex"] = hex;
    doc["ascii"] = ascii;
}

void populatePorts(JsonDocument& doc) {
    JsonArray ports = doc["ports"].to<JsonArray>();
    for (size_t i = 0; i < 2; i++) {
        JsonObject port = ports.add<JsonObject>();
        port["id"] = channels[i].id;
        port["label"] = channels[i].label;
        port["rxPin"] = channels[i].rxPin;
        port["txPin"] = channels[i].txPin;
        port["rxBytes"] = channels[i].rxBytes;
        port["txBytes"] = channels[i].txBytes;
    }
}

void populateStatus(JsonDocument& doc) {
    doc["type"] = "status";
    doc["rxBytes"] = totalRxBytes();
    doc["txBytes"] = totalTxBytes();
    doc["uptime"] = millis() / 1000;
    doc["heap"] = ESP.getFreeHeap();
    doc["baud"] = currentBaud;
    doc["databits"] = currentDataBits;
    doc["parity"] = String(currentParity);
    doc["stopbits"] = currentStopBits;
    doc["config"] = configToString();
    doc["passthroughMode"] = passthroughModeToString(currentPassthroughMode);
    populatePorts(doc);
    tbWifiStatusJson(doc);
}

void populateSettings(JsonDocument& doc) {
    doc["type"] = "settings";
    doc["baud"] = currentBaud;
    doc["databits"] = currentDataBits;
    doc["parity"] = String(currentParity);
    doc["stopbits"] = currentStopBits;
    doc["config"] = configToString();
    doc["passthroughMode"] = passthroughModeToString(currentPassthroughMode);
    populatePorts(doc);
    tbWifiSettingsJson(doc);
}

void broadcastStatus() {
    JsonDocument doc;
    populateStatus(doc);
    tbWsBroadcast(doc);
}

void saveToolPreferences() {
    Preferences prefs;
    prefs.begin(PREFS_NS, false);
    prefs.putUInt("baud", currentBaud);
    prefs.putUChar("dbits", currentDataBits);
    prefs.putUChar("parity", (uint8_t)currentParity);
    prefs.putUChar("sbits", currentStopBits);
    prefs.putUChar("ptmode", (uint8_t)currentPassthroughMode);
    prefs.end();
}

void loadToolPreferences() {
    Preferences prefs;
    prefs.begin(PREFS_NS, true);
    currentBaud = prefs.getUInt("baud", DEFAULT_BAUD);
    currentDataBits = prefs.getUChar("dbits", DEFAULT_DATABITS);
    currentParity = (char)prefs.getUChar("parity", (uint8_t)DEFAULT_PARITY);
    currentStopBits = prefs.getUChar("sbits", DEFAULT_STOPBITS);
    currentPassthroughMode = (PassthroughMode)prefs.getUChar("ptmode", (uint8_t)PASSTHROUGH_BIDIR);
    prefs.end();

    if (!resolveSerialConfig(currentDataBits, currentParity, currentStopBits, currentSerialConfig)) {
        currentBaud = DEFAULT_BAUD;
        currentDataBits = DEFAULT_DATABITS;
        currentParity = DEFAULT_PARITY;
        currentStopBits = DEFAULT_STOPBITS;
        currentSerialConfig = SERIAL_8N1;
    }
    if (currentBaud == 0) currentBaud = DEFAULT_BAUD;
    if (currentPassthroughMode > PASSTHROUGH_BIDIR) currentPassthroughMode = PASSTHROUGH_BIDIR;
}

void beginChannel(ChannelState& channel) {
    channel.uart->begin(currentBaud, currentSerialConfig, channel.rxPin, channel.txPin);
}

void reconfigureChannels() {
    for (size_t i = 0; i < 2; i++) {
        channels[i].uart->end();
        beginChannel(channels[i]);
    }
}

void clearStatsAndHistory() {
    for (size_t i = 0; i < 2; i++) {
        channels[i].rxBytes = 0;
        channels[i].txBytes = 0;
    }
    historyHead = 0;
    historyCount = 0;
}

void sendHistory(AsyncWebSocketClient* client) {
    JsonDocument resp;
    resp["type"] = "history";
    JsonArray items = resp["items"].to<JsonArray>();

    size_t start = (historyHead + HISTORY_SIZE - historyCount) % HISTORY_SIZE;
    for (size_t i = 0; i < historyCount; i++) {
        const HistoryEntry& entry = history[(start + i) % HISTORY_SIZE];
        JsonObject item = items.add<JsonObject>();
        item["ts"] = entry.ts;
        item["len"] = entry.len;
        item["port"] = String(entry.port);
        item["dir"] = (entry.dir == 'R') ? "RX" : "TX";
        item["rx"] = (entry.dir == 'R');
        item["hex"] = entry.hex;
        item["ascii"] = entry.ascii;
        if (entry.forwardedTo) item["forwardedTo"] = String(entry.forwardedTo);
    }

    tbWsReply(client, resp);
}

void sendError(AsyncWebSocketClient* client, const char* msg) {
    JsonDocument resp;
    resp["type"] = "error";
    resp["msg"] = msg;
    tbWsReply(client, resp);
}

// Parse a hex payload made of 1-2 digit hex bytes separated by spaces/commas.
// Returns the parsed byte count on success, or -1 if the payload is malformed
// or exceeds the output buffer.
int parseHexPayload(const char* input, uint8_t* out, size_t maxLen) {
    if (!input) return 0;

    size_t count = 0;
    const char* p = input;
    while (*p) {
        while (*p == ' ' || *p == ',' || *p == '\t' || *p == '\r' || *p == '\n') p++;
        if (!*p) break;
        if (!isxdigit((unsigned char)*p)) return -1;

        char token[3] = {0, 0, 0};
        token[0] = *p++;
        if (*p && isxdigit((unsigned char)*p)) {
            token[1] = *p++;
        }
        if (count >= maxLen) return -1;
        out[count++] = (uint8_t)strtoul(token, NULL, 16);

        if (*p && *p != ' ' && *p != ',' && *p != '\t' && *p != '\r' && *p != '\n') {
            return -1;
        }
    }

    return (int)count;
}

void broadcastSentEvent(int channelIndex, const uint8_t* data, size_t len, uint32_t ts) {
    JsonDocument resp;
    resp["type"] = "sent";
    resp["port"] = channels[channelIndex].id;
    resp["len"] = len;
    resp["total"] = totalTxBytes();
    resp["portTxBytes"] = channels[channelIndex].txBytes;
    resp["ts"] = ts;
    addPayloadPreview(resp, data, len);
    tbWsBroadcast(resp);
}

void sendToChannel(int channelIndex, const uint8_t* data, size_t len, bool recordHistoryEntry = true) {
    if (len == 0) return;
    channels[channelIndex].uart->write(data, len);
    channels[channelIndex].txBytes += len;
    tbLedFlash();

    uint32_t ts = millis();
    if (recordHistoryEntry) {
        storeHistory(channels[channelIndex].id[0], 'T', 0, data, len, ts);
    }
    broadcastSentEvent(channelIndex, data, len, ts);
}

void handleIncomingChannel(int channelIndex) {
    ChannelState& channel = channels[channelIndex];
    int peerIndex = channelIndex == 0 ? 1 : 0;

    while (channel.uart->available()) {
        uint8_t buffer[128];
        size_t count = 0;
        while (channel.uart->available() && count < sizeof(buffer)) {
            int value = channel.uart->read();
            if (value < 0) break;
            buffer[count++] = (uint8_t)value;
        }
        if (count == 0) break;

        uint32_t ts = millis();
        channel.rxBytes += count;
        bool forwarded = passthroughEnabledFor(channelIndex);
        if (forwarded) {
            channels[peerIndex].uart->write(buffer, count);
            channels[peerIndex].txBytes += count;
        }
        tbLedFlash();
        storeHistory(channel.id[0], 'R', forwarded ? channels[peerIndex].id[0] : 0, buffer, count, ts);

        JsonDocument resp;
        resp["type"] = "rx";
        resp["port"] = channel.id;
        resp["len"] = count;
        resp["total"] = totalRxBytes();
        resp["portRxBytes"] = channel.rxBytes;
        resp["ts"] = ts;
        if (forwarded) {
            resp["forwardedTo"] = channels[peerIndex].id;
            resp["peerTxBytes"] = channels[peerIndex].txBytes;
        }
        addPayloadPreview(resp, buffer, count);
        tbWsBroadcast(resp);
    }
}

// ============ WEBSOCKET HANDLER ============
void handleToolWS(AsyncWebSocketClient* client, JsonDocument& doc) {
    const char* cmd = doc["cmd"];
    if (!cmd) return;

    if (strcmp(cmd, "status") == 0) {
        JsonDocument resp;
        populateStatus(resp);
        tbWsReply(client, resp);
    }
    else if (strcmp(cmd, "settings") == 0) {
        JsonDocument resp;
        populateSettings(resp);
        tbWsReply(client, resp);
    }
    else if (strcmp(cmd, "getHistory") == 0) {
        sendHistory(client);
    }
    else if (strcmp(cmd, "sendAscii") == 0) {
        String payload = doc["data"] | "";
        if (doc["crlf"] | false) payload += "\r\n";
        int channelIndex = channelIndexFromId(doc["port"] | "A");
        sendToChannel(channelIndex, (const uint8_t*)payload.c_str(), payload.length());
    }
    else if (strcmp(cmd, "sendHex") == 0) {
        const char* raw = doc["data"] | "";
        uint8_t buffer[128];
        int len = parseHexPayload(raw, buffer, sizeof(buffer));
        if (len < 0) {
            sendError(client, "Invalid hex payload");
            return;
        }
        int channelIndex = channelIndexFromId(doc["port"] | "A");
        sendToChannel(channelIndex, buffer, (size_t)len);
    }
    else if (strcmp(cmd, "setSerial") == 0) {
        uint32_t baud = doc["baud"] | DEFAULT_BAUD;
        uint8_t dataBits = doc["databits"] | DEFAULT_DATABITS;
        const char* parityValue = doc["parity"] | "N";
        uint8_t stopBits = doc["stopbits"] | DEFAULT_STOPBITS;
        uint32_t serialConfig = SERIAL_8N1;

        if (baud == 0 || baud > 2000000UL || !resolveSerialConfig(dataBits, parityValue[0], stopBits, serialConfig)) {
            sendError(client, "Invalid serial settings");
            return;
        }

        currentBaud = baud;
        currentDataBits = dataBits;
        currentParity = toupper((unsigned char)parityValue[0]);
        currentStopBits = stopBits;
        currentSerialConfig = serialConfig;
        reconfigureChannels();
        saveToolPreferences();

        JsonDocument resp;
        resp["type"] = "serialConfig";
        resp["baud"] = currentBaud;
        resp["databits"] = currentDataBits;
        resp["parity"] = String(currentParity);
        resp["stopbits"] = currentStopBits;
        resp["config"] = configToString();
        tbWsBroadcast(resp);
        broadcastStatus();
    }
    else if (strcmp(cmd, "setPassthrough") == 0) {
        currentPassthroughMode = parsePassthroughMode(doc["mode"] | "both");
        saveToolPreferences();

        JsonDocument resp;
        resp["type"] = "passthroughConfig";
        resp["mode"] = passthroughModeToString(currentPassthroughMode);
        tbWsBroadcast(resp);
        broadcastStatus();
    }
    else if (strcmp(cmd, "savewifi") == 0) {
        const char* ssid = doc["ssid"];
        const char* pass = doc["pass"];
        if (ssid && strlen(ssid) > 0 && strlen(ssid) <= 32) {
            int wifiMode = doc["wifiMode"] | -1;
            const char* staSSID = doc["staSSID"] | (const char*)NULL;
            const char* staPass = doc["staPass"] | (const char*)NULL;
            const char* mdnsHost = doc["mdnsHost"] | (const char*)NULL;
            tbWifiSave(PREFS_NS, ssid, pass ? pass : "", wifiMode, staSSID, staPass, mdnsHost);
        }
    }
    else if (strcmp(cmd, "wifiscan") == 0) {
        JsonDocument resp;
        tbWifiScanJson(resp);
        tbWsReply(client, resp);
    }
    else if (strcmp(cmd, "clearHistory") == 0) {
        clearStatsAndHistory();
        JsonDocument resp;
        resp["type"] = "cleared";
        tbWsBroadcast(resp);
        broadcastStatus();
    }
}

// ============ SETUP ============
void setup() {
    Serial.begin(115200);
    delay(1000);

    tbLedBegin();
    tbWifiBegin("SerialTool", "serial1234", PREFS_NS, "serialtool");
    loadToolPreferences();
    tbWebBegin(INDEX_HTML_GZ, INDEX_HTML_GZ_LEN, handleToolWS);
    tbOtaBegin();

    beginChannel(channels[0]);
    beginChannel(channels[1]);

    Serial.println("\n  RS-232 Serial Tool ready.");
    Serial.printf("  Channel A RX/TX: GPIO%u/GPIO%u\n", channels[0].rxPin, channels[0].txPin);
    Serial.printf("  Channel B RX/TX: GPIO%u/GPIO%u\n", channels[1].rxPin, channels[1].txPin);
    Serial.printf("  Serial config: %lu %s\n", (unsigned long)currentBaud, configToString());
    Serial.printf("  Passthrough: %s\n\n", passthroughModeToString(currentPassthroughMode));
}

// ============ LOOP ============
void loop() {
    handleIncomingChannel(0);
    handleIncomingChannel(1);

    tbWifiLoop();
    tbWebLoop();
    tbOtaLoop();
    tbLedBlink();
    yield();
}
