#ifndef TOOLBOX_WEB_H
#define TOOLBOX_WEB_H

/*
 * Toolbox Base — Web Server
 * Shared AsyncWebServer + WebSocket setup, gzip PROGMEM serving
 *
 * Usage in your tool's main.cpp:
 *   #include "toolbox_web.h"
 *   #include "web_ui_gz.h"   // generated by build_web.py
 *
 *   void handleToolWS(AsyncWebSocketClient* client, JsonDocument& doc);
 *
 *   void setup() {
 *       tbWebBegin(INDEX_HTML_GZ, INDEX_HTML_GZ_LEN, handleToolWS);
 *   }
 *   void loop() {
 *       tbWebLoop();
 *   }
 */

#include <Arduino.h>
#include <ESPAsyncWebServer.h>
#include <AsyncTCP.h>
#include <ArduinoJson.h>

// ---- Globals (shared) ----
static AsyncWebServer _tbServer(80);
static AsyncWebSocket _tbWs("/ws");

// Tool WS handler callback type
typedef void (*TbWsHandler)(AsyncWebSocketClient* client, JsonDocument& doc);
static TbWsHandler _tbToolHandler = nullptr;

// ---- WebSocket plumbing ----

static void _tbHandleWsMessage(AsyncWebSocketClient* client, void* arg,
                                uint8_t* data, size_t len) {
    AwsFrameInfo* info = (AwsFrameInfo*)arg;
    if (info->final && info->index == 0 && info->len == len && info->opcode == WS_TEXT) {
        data[len] = 0;

        JsonDocument doc;
        if (deserializeJson(doc, (char*)data)) return;
        if (!doc["cmd"]) return;

        if (_tbToolHandler) {
            _tbToolHandler(client, doc);
        }
    }
}

static void _tbOnWsEvent(AsyncWebSocket* server, AsyncWebSocketClient* client,
                          AwsEventType type, void* arg, uint8_t* data, size_t len) {
    switch (type) {
        case WS_EVT_CONNECT:
            Serial.printf("WS client #%u connected from %s\n",
                          client->id(), client->remoteIP().toString().c_str());
            break;
        case WS_EVT_DISCONNECT:
            Serial.printf("WS client #%u disconnected\n", client->id());
            break;
        case WS_EVT_DATA:
            _tbHandleWsMessage(client, arg, data, len);
            break;
        case WS_EVT_PONG:
        case WS_EVT_ERROR:
            break;
    }
}

// ---- Public API ----

/**
 * Get a reference to the WebSocket for broadcasting.
 * Use: tbWs().textAll(json);
 */
inline AsyncWebSocket& tbWs() { return _tbWs; }

/**
 * Get a reference to the web server for adding custom routes.
 */
inline AsyncWebServer& tbServer() { return _tbServer; }

/**
 * Send a JSON object to all connected WebSocket clients.
 */
template <typename TDoc>
inline void tbWsBroadcast(TDoc& doc) {
    String json;
    serializeJson(doc, json);
    _tbWs.textAll(json);
}

/**
 * Send a JSON object to a specific client.
 */
template <typename TDoc>
inline void tbWsReply(AsyncWebSocketClient* client, TDoc& doc) {
    String json;
    serializeJson(doc, json);
    client->text(json);
}

/**
 * Initialize web server with gzipped HTML + WS handler.
 *
 * @param gzData     Pointer to gzipped HTML byte array (PROGMEM)
 * @param gzLen      Length of gzipped data
 * @param handler    Your tool's WS message handler
 */
inline void tbWebBegin(const uint8_t* gzData, size_t gzLen, TbWsHandler handler) {
    _tbToolHandler = handler;

    _tbWs.onEvent(_tbOnWsEvent);
    _tbServer.addHandler(&_tbWs);

    // Serve gzipped HTML from PROGMEM
    _tbServer.on("/", HTTP_GET, [gzData, gzLen](AsyncWebServerRequest* request) {
        AsyncWebServerResponse* response =
            request->beginResponse(200, "text/html", gzData, gzLen);
        response->addHeader("Content-Encoding", "gzip");
        request->send(response);
    });

    _tbServer.begin();
    Serial.println("  Web server started on port 80");
}

/**
 * Call in loop() — cleans up disconnected WS clients.
 */
inline void tbWebLoop() {
    _tbWs.cleanupClients();
}

#endif // TOOLBOX_WEB_H
